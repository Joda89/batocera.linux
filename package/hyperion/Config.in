## package/hyperion/Config.in
```kconfig
config BR2_PACKAGE_HYPERION
	bool "Hyperion"
	select BR2_INSTALL_LIBSTDCPP
	select BR2_PACKAGE_LIBUSB
	select BR2_PACKAGE_QT5
	select BR2_PACKAGE_QT5BASE
	select BR2_PACKAGE_QT5BASE_GUI
	select BR2_PACKAGE_QT5BASE_NETWORK
	select BR2_PACKAGE_QT5BASE_WIDGETS	
	select BR2_PACKAGE_QT5SERIALPORT
	select BR2_PACKAGE_QT5SVG
	select BR2_PACKAGE_PROTOBUF
	select BR2_PACKAGE_LIBCEC
	select BR2_PACKAGE_FLATBUFFERS
	select BR2_PACKAGE_JPEG_TURBO
	select BR2_PACKAGE_AVAHI
	select BR2_PACKAGE_QT5BASE_SQL
	select BR2_PACKAGE_QT5BASE_SQLITE_SYSTEM
	help
	  Hyperion is an open source ambient light software.
	  https://github.com/hyperion-project/hyperion
```
